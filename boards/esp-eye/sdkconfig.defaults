## boards/esp-eye/sdkconfig.defaults
```kconfig
# Board: Espressif ESP-EYE (ESP32-WROVER + OV2640/OV3660, 4 MB flash + PSRAM).
#
# This is NOT a target board for the handheld — it is the bench capture camera aimed
# at the panel under test (hardware-in-the-loop verification, see
# docs/hardware/pico-e32-bench-camera.md). Only pico-e32-bench-cam builds for it.
CONFIG_IDF_TARGET="esp32"
CONFIG_ESPTOOLPY_FLASHSIZE_4MB=y
CONFIG_ESP_DEFAULT_CPU_FREQ_MHZ_240=y

# Camera framebuffers need PSRAM.
CONFIG_SPIRAM=y
CONFIG_SPIRAM_USE_MALLOC=y
```

## boards/m5stack-timer-cam/sdkconfig.defaults
```kconfig
# Board: M5Stack Timer Camera F (ESP32-D0WDQ6-V3 + OV3660 fisheye, 4 MB flash + 8 MB PSRAM).
#
# This is NOT a target board for the handheld — it is the bench capture camera aimed at the
# panel under test (hardware-in-the-loop verification, see
# docs/hardware/pico-e32-bench-camera.md). Only pico-e32-bench-cam builds for it.
CONFIG_IDF_TARGET="esp32"
CONFIG_ESPTOOLPY_FLASHSIZE_4MB=y
CONFIG_ESP_DEFAULT_CPU_FREQ_MHZ_240=y

# Camera framebuffers need PSRAM.
CONFIG_SPIRAM=y
CONFIG_SPIRAM_USE_MALLOC=y
```

## boards/makerfabs-ili9488-r1/sdkconfig.defaults
```kconfig
# Board: Makerfabs "ESP32-S3 Parallel TFT with Touch (ILI9488)", 3.5", 320x480.
# Module ESP32-S3-WROOM-1-N16R2 = 16 MB flash + 2 MB QUAD PSRAM, 240 MHz.
# The board owns CONFIG_IDF_TARGET; apps layer their own config on top.
CONFIG_IDF_TARGET="esp32s3"
CONFIG_ESPTOOLPY_FLASHSIZE_16MB=y
CONFIG_ESP_DEFAULT_CPU_FREQ_MHZ_240=y

CONFIG_SPIRAM=y
CONFIG_SPIRAM_MODE_QUAD=y
CONFIG_SPIRAM_SPEED_80M=y
CONFIG_SPIRAM_USE_MALLOC=y
```

## boards/makerfabs-st7701-4in/sdkconfig.defaults
```kconfig
# Board: Makerfabs "ESP32-S3 Parallel TFT with Touch 4.0"" (ST7701), 480x480 RGB.
# Module ESP32-S3-WROOM-1-N16R8 = 16 MB flash + 8 MB OCTAL PSRAM, 240 MHz.
# Later target (behind Gate #5, the RGB drift soak test). See the development plan.
CONFIG_IDF_TARGET="esp32s3"
CONFIG_ESPTOOLPY_FLASHSIZE_16MB=y
CONFIG_ESP_DEFAULT_CPU_FREQ_MHZ_240=y

CONFIG_SPIRAM=y
CONFIG_SPIRAM_MODE_OCT=y
CONFIG_SPIRAM_SPEED_80M=y
CONFIG_SPIRAM_USE_MALLOC=y
```

## firmware/pico-e32-bench-cam/sdkconfig.defaults
```kconfig
# App config for the bench camera. Target/PSRAM come from boards/m5stack-timer-cam/.
CONFIG_ESP_MAIN_TASK_STACK_SIZE=8192

# Pin SCCB to the legacy I2C driver to match cam_main.c's probe diagnostics, which use the
# legacy driver/i2c.h API. ESP-IDF refuses to run both I2C drivers in one app: leaving this
# at the component default (..._NEW) aborts at boot with
#   "CONFLICT! driver_ng is not allowed to be used with this old driver"
# and boot-loops. Drop this line only together with porting those diagnostics to
# driver/i2c_master.h.
CONFIG_SCCB_HARDWARE_I2C_DRIVER_LEGACY=y
CONFIG_COMPILER_OPTIMIZATION_PERF=y
# JPEG frames can exceed the default 4 KB HTTP send; keep the server roomy.
CONFIG_HTTPD_MAX_REQ_HDR_LEN=1024
```

## firmware/pico-e32-display-test/sdkconfig.defaults
```kconfig
# App-level config for pico-e32-display-test. Board/target/PSRAM come from
# boards/<BOARD>/sdkconfig.defaults (layered first by the top-level Makefile).
CONFIG_COMPILER_OPTIMIZATION_PERF=y
```

## firmware/pico-e32-fake08/sdkconfig.defaults
```kconfig
# App-level config for pico-e32-fake08. Board/target/PSRAM come from boards/<BOARD>/sdkconfig.defaults
# (layered first by the top-level Makefile).

# app_main runs fake-08's GameLoop directly; the Lua pcall path + graphics calls want a roomy C stack.
CONFIG_ESP_MAIN_TASK_STACK_SIZE=32768

CONFIG_COMPILER_OPTIMIZATION_PERF=y

# Frame pacing: the GameLoop caps at 30 fps with vTaskDelay, which sleeps in whole FreeRTOS ticks.
# At the IDF default 100 Hz (10 ms/tick) a 33.3 ms target quantizes to ±10 ms — frames land at
# 20/30/40 ms and the game visibly judders even though the per-frame WORK is only ~6 ms (measured:
# Step 2.6 ms + drawFrame 3.6 ms). A 1 ms tick gives the pacer 1 ms granularity → smooth 30 fps.
CONFIG_FREERTOS_HZ=1000

# z8lua opcode dispatch is faster with jump tables (see components/z8lua/CMakeLists.txt); the component
# already forces them for the interpreter.

# SD cart loader: FATFS long filenames (default IDF uses 8.3 short names, which mangle/hide .p8 cart
# names). LFN_HEAP (not _STACK — the main task stack is already stretched for Lua); UTF-8 so non-ASCII
# cart names survive.
CONFIG_FATFS_LFN_HEAP=y
CONFIG_FATFS_MAX_LFN=255
CONFIG_FATFS_API_ENCODING_UTF_8=y

# Assertions OFF (release/perf) — pairs with COMPILER_OPTIMIZATION_PERF above. A fresh sdkconfig defaults
# compiler assertions ON (level 2), and on this esp-idf/newlib the FIRST printh at boot (fwrite -> the newlib
# recursive stdio lock, __retarget_lock_acquire_recursive) trips FreeRTOS' configASSERT (= plain assert()) on
# an otherwise-working stdio path, boot-looping any ASCII-telemetry (printh) build. This pins the config the
# board was actually validated under (cleared Celeste deterministically + measured fps). The underlying strict
# stdio-lock check is benign here; see docs/worklog/2026-07-20-celeste-closed-loop-fc-scheduled.md.
CONFIG_COMPILER_OPTIMIZATION_ASSERTIONS_DISABLE=y

# UART-only console. This board talks over its CP2104 UART, NOT USB-Serial-JTAG, but a fresh sdkconfig defaults
# the ESP32-S3 SECONDARY console to USB-Serial-JTAG — which adds a second stdout path whose recursive stdio lock
# is what tripped the boot assert above, and (with the assert masked) corrupts the cart's first printh so the
# Lua coroutine dies (fc frozen at 1, no player spawns). Pin the console to UART-only, matching the validated
# config the board was actually developed + demoed under.
CONFIG_ESP_CONSOLE_SECONDARY_NONE=y
```

## firmware/pico-e32-host/sdkconfig.defaults
```kconfig
# App-level config for pico-e32-host. Board/target/PSRAM come from
# boards/<BOARD>/sdkconfig.defaults (layered first by the top-level Makefile).
CONFIG_ESP_MAIN_TASK_STACK_SIZE=16384
CONFIG_COMPILER_OPTIMIZATION_PERF=y
```

## firmware/pico-e32-luabench/sdkconfig.defaults
```kconfig
# App-level config for pico-e32-luabench. Board/target/PSRAM come from
# boards/<BOARD>/sdkconfig.defaults (layered first by the top-level Makefile).
CONFIG_ESP_MAIN_TASK_STACK_SIZE=16384
CONFIG_COMPILER_OPTIMIZATION_PERF=y   # -O2; -Os measured no better for the z8lua VM (worklog 2026-07-14 gate2)

# This is a throughput benchmark: the timed loop runs Lua flat-out in app_main
# without yielding, which starves the idle task and trips the Task Watchdog (~5 s).
# The WDT is irrelevant to the measurement and its backtrace print would corrupt the
# timed case it fires in, so disable it for this harness.
CONFIG_ESP_TASK_WDT_INIT=n
```
